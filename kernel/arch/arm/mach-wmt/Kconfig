## kernel/arch/arm/mach-wmt/Kconfig
```kconfig
if ARCH_WMT

menu "WonderMedia Technology Implementations"

config WMT_EVB
        bool "WonderMedia Technology Evaluation Board"
        depends on ARCH_WMT
        default y
	---help---
	  Say Y here if you want to config the WonderMedia Technology specific parameters.

choice
	prompt "Select WonderMedia Technology evaluation board type"
	depends on WMT_EVB
	default WM0001
	---help---
	  Choose the type of WonderMedia Technology evaluation board type.
	  There are four types of WonderMedia Technology EVB, depend on the mounted components.

config WM0001
	bool "WM0001"
	---help---
	  Say Y here if you intend to build kernel on VT9043A1.

endchoice

config WMT_USE_BOOTLOADER_ATAG
	bool "Bootloader kernel parameter support"
	depends on WMT_EVB
	---help---
	Say Y here if you want to use kernel parameters passed from the arm bootloader.

config WMT_FIXUP_ATAG
	bool "Force to fixup kernel parameter"
	depends on WMT_EVB && WMT_USE_BOOTLOADER_ATAG
	---help---
	  Say Y here if you want to fixup the WonderMedia Technology kernel boot parameters.
	  It is a temp solution if ATAG passing have problem or you don't 
	  know how exactly setup kernel parameters.

comment "Select WonderMedia Technology based drivers"

config WMT_REGMON
	tristate "WonderMedia Technology registers monitor (EXPERIMENTAL)"

	---help---
	  Say Y here if you want to access WonderMedia Technology registers via proc_fs interface.
	  Users can access WonderMedia Technology registers via /proc/wmt/registers/XXXX files.
	  This program designed to be a monitor of WonderMedia Technology registers.
	  It is just for debugging and testing purpose under the runtime kernel,
	  but notice that I did not implement it with full supporting to all
	  registers because there are some registers are not appropriate to show
	  to users, such as registers with read to clean behavior.

	  Before using this interface, users should know the registers behavior.
	  Detail registers behavior please refer to WonderMedia Technology hardware relative
	  documents.

choice
	prompt "Select registers monotor read interface format"
	depends on WMT_REGMON
	default WMT_REGMON_RF_A

	---help---
	  Choose the format of registers monitor read interface.

config WMT_REGMON_RF_A
	bool "Only value"

	---help---
	  This is a basic format of register monotor interface.

	  In the reading of each register, it will only return the value
	  of this register.

config WMT_REGMON_RF_B
	bool "Value and register description"

	---help---
	  This is an extended format of register monotor interface.

	  In the reading of each register, it will return the value
	  of this register plus a simple description about the name of
	  this register.
endchoice

config WMT_REGMON_WF
	bool "Registers monitor write interface (DANGEROUS)"
	depends on WMT_REGMON

	---help---
	  Say Y here if you want the writing interface in register monotor.
	  Say N here the dirver will ignore any writing via write interface.

	  The DANGEROUS means you must know about the behavior of specific
	  registers, if you don't know, writing somecritical registers might
	  cause the whole system crached.

	  Detail registers behavior please refer to VT8610 hardware relative
	  documents.
	  
	  
endmenu

endif
```

## kernel/drivers/blcr/Kconfig
```kconfig
#

#

menu "BLCR Support"

config BLCR_SUPPORT
    tristate "Blcr Support"
    default y
	help
	  blcr--checkpoint and restore
	  
endmenu
```

## kernel/drivers/crypto/Kconfig
```kconfig
#
# CRYPTO CONFIGURATION
#

menu "Hardware crypto devices"

config CRYPTO_DEV_WMT_SE
	tristate "WMT Hardware security engine"
	default y
	help
	  For WMT hardware security engine

endmenu
```

## kernel/drivers/input/rmtctl/Kconfig
```kconfig
#
# Input core configuration
#
config INPUT_RMTCTL
	bool "Remote controllers" if EMBEDDED || !X86
	default y
	depends on INPUT
	help
	  Say Y here, and a list of supported remote control devices will 
	  be displayed. This option doesn't affect the kernel.

	  If unsure, say Y.

config RMTCTL_WonderMedia
	tristate "WonderMedia remote control support" if !PC
	default y
	depends on INPUT && INPUT_RMTCTL
	help
	  Say Y here if you want remote control support for WonderMedia.

	  If unsure, say Y.

	  To compile this driver as a module, choose M here: the
	  module will be called atkbd.
```

## kernel/drivers/input/sensor/Kconfig
```kconfig
#
# WMT Sensor configuration
#
menuconfig INPUT_SENSOR
	bool "WMT Sensor"
	help
	  Say Y here, and a list of supported sensor will be displayed.
	  This option doesn't affect the kernel.

	  If unsure, say Y.

if INPUT_SENSOR

config WMT_SENSOR_MMA7660
	tristate "MMA7660 G-Sensor Support"
	depends on ARCH_WMT
	help
	  Say Y here if you have an WMT based board with g-sensor 
	  attached to it.

	  If unsure, say N.

	  To compile this driver as a module, choose M here: the
	  module will be called sensor_mma7660.

config WMT_SENSOR_KXTE9
	tristate "KXTE9 G-Sensor Support"
	depends on ARCH_WMT
	help
	  Say Y here if you have an WMT based board with g-sensor 
	  attached to it.

	  If unsure, say N.

	  To compile this driver as a module, choose M here: the
	  module will be called sensor_kxte9.
endif
```

## kernel/drivers/input/touchscreen/vt1603a_ts/Kconfig
```kconfig
config WMT_VT1603A_TOUCHSCREEN
        tristate "WonderMedia VT1603 Touchscreen Device Support"
        default m
        depends on ARCH_WMT
        ---help---
          Say Y here if you have an WMT based board with touchscreen
          attached to it.
          If unsure, say N.
          To compile this driver as a module, choose M here: the
          module will be called vt1603_ts.

choice
    prompt "VT1603 TouchPanel interface Select"
    depends on WMT_VT1603A_TOUCHSCREEN
    default VT1603_TS_I2C
config VT1603_TS_SPI
        bool "SPI"
        ---help---
          Say Y here if you want to use SPI bus.
config VT1603_TS_I2C
        bool "I2C"
        ---help---
          Say Y here if you want to use I2C bus.
endchoice
```

## kernel/drivers/media/video/wmt/Kconfig
```kconfig
#
# Multimedia Video device configuration
#

config WMT_VIDEO_LOCK
	tristate "WonderMedia Video Lock"
	---help---
	  Say Y here to enable Video Lock

config WMT_VIDEO_DMA
	tristate "WonderMedia Video DMA"
	---help---
	  Say Y here to enable Video DMA.
```

## kernel/drivers/media/video/wmt/divx/Kconfig
```kconfig
#
# Multimedia Video device configuration
#

config WMT_VIDEO_DECODE_DIVX
	tristate "WonderMedia Hardware DIVX decoder"
	---help---
	  Say Y here to use hardware to decode DIVX files
```

## kernel/drivers/media/video/wmt/encode/h264/Kconfig
```kconfig
#
# Multimedia Video device configuration
#

config WMT_VIDEO_ENCODE_H264
	tristate "WonderMedia Hardware H264 encoder"
	---help---
	  Say Y here to use hardware to encode H264 files
```

## kernel/drivers/media/video/wmt/h263/Kconfig
```kconfig
#
# Multimedia Video device configuration
#

config WMT_VIDEO_DECODE_H263
	tristate "WonderMedia Hardware H263 decoder"
	---help---
	  Say Y here to use hardware to decode H263 files
```

## kernel/drivers/media/video/wmt/h264/Kconfig
```kconfig
#
# Multimedia Video device configuration
#

config WMT_VIDEO_DECODE_H264
	tristate "WonderMedia Hardware H264 decoder"
	---help---
	  Say Y here to use hardware to decode H264 files
```

## kernel/drivers/media/video/wmt/jpeg/Kconfig
```kconfig
#
# Multimedia Video device configuration
#

config WMT_VIDEO_DECODE_JPEG
	tristate "WonderMedia Hardware JPEG decoder"
	---help---
	  Say Y here to use hardware to decode JPEG files	
  

 	
```

## kernel/drivers/media/video/wmt/mpeg2/Kconfig
```kconfig
#
# Multimedia Video device configuration
#

config WMT_VIDEO_DECODE_MPEG2
	tristate "WonderMedia Hardware MPEG 1/2 decoder"
	---help---
	  Say Y here to use hardware to decode MPEG 1/2 files
```

## kernel/drivers/media/video/wmt/mpeg4/Kconfig
```kconfig
#
# Multimedia Video device configuration
#

config WMT_VIDEO_DECODE_MPEG4
	tristate "WonderMedia Hardware MPEG4 decoder"
	---help---
	  Say Y here to use hardware to decode MPEG4 files
```

## kernel/drivers/media/video/wmt/rv/Kconfig
```kconfig
#
# Multimedia Video device configuration
#

config WMT_VIDEO_DECODE_RV
	tristate "WonderMedia Hardware RV decoder"
	---help---
	  Say Y here to use hardware to decode RV files	
  

 	
```

## kernel/drivers/media/video/wmt/vc1/Kconfig
```kconfig
#
# Multimedia Video device configuration
#

config WMT_VIDEO_DECODE_VC1
	tristate "WonderMedia Hardware VC1 decoder"
	---help---
	  Say Y here to use hardware to decode VC1 files	
  

 	
```

## kernel/drivers/media/video/wmt_v4l2/cmos/Kconfig
```kconfig
#
# Multimedia Video device configuration
#

config WMT_V4L2_CMOS
	tristate "WonderMedia V4L2 CMOS Support"
	default y
	---help---
	  Say Y here to use hardware CMOS Support.

 	
  
	
```

## kernel/drivers/media/video/wmt_v4l2/tv_decoder/Kconfig
```kconfig
#
# Multimedia Video device configuration
#

config WMT_V4L2_TV_DECODER
	tristate "WonderMedia V4L2 TV_DECODER Support"
	default y
	---help---
	  Say Y here to use hardware TV_DECODER Support.


  

 	
```

## kernel/drivers/power/vt1603/Kconfig
```kconfig
config WMT_VT1603_BATTERY
        tristate "WonderMedia VT1603 Battery Support"
        default m
        depends on ARCH_WMT
        ---help---
          Say Y here if you have an WMT based board with battery
          attached to it.
          If unsure, say N.
          To compile this driver as a module, choose M here: the
          module will be called vt1603_bat.

choice
    prompt "VT1603 Battery interface Select"
    default VT1603_BAT_I2C
    depends on WMT_VT1603_BATTERY
config VT1603_BAT_SPI
        bool "SPI"
        ---help---
          Say Y here if you want to use SPI bus.
config VT1603_BAT_I2C
        bool "I2C"
        ---help---
          Say Y here if you want to use I2C bus.
endchoice

config VT1603_BATTERY_ENABLE
        bool "VT1603 Battery Detecting Support"
        default y
        depends on WMT_VT1603_BATTERY
        ---help---
          Say Y here if you want to enable battery detecting.

config VT1603_BATTERY_ALARM
        bool "VT1603 Battery Alarm Support"
        default y
        depends on WMT_VT1603_BATTERY
        ---help---
          Say Y here if you want to enable battery alarm.
```

## kernel/sound/soc/wmt/Kconfig
```kconfig
config SND_WMT_SOC
	bool "SoC Audio for the WMT chip"
	depends on ARCH_WMT && SND && SND_SOC
	help
	  Say Y or M if you want to add support for codecs attached to
	  the WMT AC97, I2S interface. You will also need
	  to select the audio interfaces to support below.

#
# WMT ALSA I2S driver
#
config SND_WMT_SOC_I2S
        bool "SoC I2S Audio support for WMT"
        depends on SND_WMT_SOC
        ---help---
          Say Y or M if you want to add support for codecs attached to
	  		the WMT I2S interface.

config I2S_HW_DAC
        bool "HW_DAC"
        depends on SND_WMT_SOC_I2S
        select SND_SOC_HWDAC
        ---help---
          Say Y here if you want to use HW DAC.
          	  		
config I2S_CODEC_VT1602
        bool "VT1602"
        depends on SND_WMT_SOC_I2S
        select SND_SOC_VT1602
        ---help---
          Say Y here if you want to use VT1602 as the I2S Codec.
          
config I2S_CODEC_WM8900
        bool "WM8900"
        depends on SND_WMT_SOC_I2S
        select SND_SOC_WM8900
        ---help---
          Say Y here if you want to use WM8900 as the I2S Codec.
          
config I2S_CODEC_VT1603
        bool "VT1603"
        depends on SND_WMT_SOC_I2S
        select SND_SOC_VT1603
        ---help---
          Say Y here if you want to use VT1603 as the I2S Codec.
```
